## sdkconfig.defaults
```kconfig
CONFIG_AUTOSTART_ARDUINO=y
# CONFIG_WS2812_LED_ENABLE is not set
CONFIG_FREERTOS_HZ=1000
CONFIG_MBEDTLS_PSK_MODES=y
CONFIG_MBEDTLS_KEY_EXCHANGE_PSK=y

CONFIG_BTDM_CTRL_BLE_MAX_CONN=4
CONFIG_BTDM_CTRL_BLE_MAX_CONN_EFF=4
```
